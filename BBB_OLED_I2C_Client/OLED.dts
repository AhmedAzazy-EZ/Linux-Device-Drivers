/dts-v1/;/plugin/;/{ /* this is our device tree overlay root node */  fragment@0 {    target = <&i2c2>;    __overlay__ {      clock-frequency = <100000>;      status = "okay";      OLED: OLED@78 {        compatible = "OLED_SSD1306";        #address-cells = <1>;        #size-cells = <0>;        reg = <0x78>;      };    };  };}; /* root node end */